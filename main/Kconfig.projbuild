## main/Kconfig.projbuild
```kconfig
menu "SignalK Instrument Panel"

    config WIFI_SSID
        string "WiFi SSID"
        default "YourSSID"
        help
            SSID of the WiFi network to connect to.

    config WIFI_PASSWORD
        string "WiFi Password"
        default "YourPassword"
        help
            Password for the WiFi network.

    config SIGNALK_WS_URI
        string "SignalK WebSocket URI"
        default "ws://192.168.1.100:3000/signalk/v1/stream?subscribe=none"
        help
            Full WebSocket URI for the SignalK server stream endpoint.
            For dev: ws://<mac-local-ip>:3000/signalk/v1/stream?subscribe=none
            Start the dev server: cd ../signalk-server && node bin/signalk-server --sample-n2k-data --override-timestamps
            Find Mac IP: ipconfig getifaddr en0

    config SIGNALK_MDNS_TIMEOUT_MS
        int "mDNS discovery timeout (ms)"
        default 3000
        range 1000 10000
        help
            How long to wait for mDNS service discovery before falling back
            to the configured WebSocket URI.

    config SIGNALK_RECONNECT_MS
        int "SignalK reconnect interval (ms)"
        default 5000
        range 1000 30000
        help
            Time in milliseconds to wait before reconnecting after disconnect.

    config DISPLAY_UPDATE_MS
        int "Display update interval (ms)"
        default 1000
        range 250 5000
        help
            How often the instrument display refreshes from live data.

    config DATA_STALE_MS
        int "Data stale threshold (ms)"
        default 10000
        range 2000 60000
        help
            Data older than this shows as '--' on the display.

endmenu
```

## sdkconfig.defaults
```kconfig
# ESP32-P4 base config
CONFIG_IDF_TARGET="esp32p4"

# Silicon revision floor — Waveshare ESP32-P4-WIFI6-Touch-LCD-4B boards ship
# with v0.x or v1.x dies. IDF v5.5 bumped the default minimum to v3.1, which
# bakes a chip-rev gate into the bootloader that bricks older silicon at boot
# (esptool --force only bypasses the host-side check; the bootloader's own
# runtime check still aborts).
#
# IDF v5.5 also gated the v0.x/v1.x choices behind ESP32P4_SELECTS_REV_LESS_V3.
# Without that flag, REV_MIN_0/1/100 are invisible to Kconfig and silently
# ignored if set in defaults — both lines below are required on v5.5+.
# (On v5.4 the SELECTS_REV_LESS_V3 line is unrecognized and ignored as a
# warning, so this stays forward- and backward-compatible.)
CONFIG_ESP32P4_SELECTS_REV_LESS_V3=y
CONFIG_ESP32P4_REV_MIN_0=y

# PSRAM - 8MB HEX (16-line) PSRAM on ESP32-P4
# P4 uses SPIRAM_MODE_HEX (only option) and SPIRAM_SPEED_200M
# 200MHz requires IDF_EXPERIMENTAL_FEATURES; 20MHz default causes DSI DPI underrun
CONFIG_IDF_EXPERIMENTAL_FEATURES=y
CONFIG_SPIRAM=y
CONFIG_SPIRAM_MODE_HEX=y
CONFIG_SPIRAM_SPEED_200M=y
CONFIG_SPIRAM_USE_MALLOC=y
CONFIG_SPIRAM_MALLOC_ALWAYSINTERNAL=16384

# Flash
CONFIG_ESPTOOLPY_FLASHSIZE_16MB=y
CONFIG_PARTITION_TABLE_CUSTOM=y
CONFIG_PARTITION_TABLE_CUSTOM_FILENAME="partitions.csv"

# WiFi via ESP32-C6 coprocessor (esp-hosted over SDIO)
# DO NOT set CONFIG_ESP_HOST_WIFI_ENABLED — it stubs the PHY and force-disables esp_wifi_remote
# esp_wifi_remote + esp_hosted route all esp_wifi_* calls to the C6 over SDIO
CONFIG_SLAVE_IDF_TARGET_ESP32C6=y
CONFIG_ESP_WIFI_STATIC_RX_BUFFER_NUM=4
CONFIG_ESP_WIFI_DYNAMIC_RX_BUFFER_NUM=8
CONFIG_ESP_WIFI_DYNAMIC_TX_BUFFER=y
CONFIG_ESP_WIFI_TX_BUFFER_TYPE=1

# LVGL memory - use malloc (backed by 32MB PSRAM) instead of 32KB internal pool
CONFIG_LV_MEM_CUSTOM=y

# LVGL fonts (required for instrument display)
CONFIG_LV_FONT_MONTSERRAT_14=y
CONFIG_LV_FONT_MONTSERRAT_16=y
CONFIG_LV_FONT_MONTSERRAT_24=y
CONFIG_LV_FONT_MONTSERRAT_28=y
CONFIG_LV_FONT_MONTSERRAT_36=y
CONFIG_LV_FONT_MONTSERRAT_48=y
CONFIG_LV_FONT_FMT_TXT_LARGE=y
CONFIG_LV_USE_FONT_PLACEHOLDER=y

# LVGL features
CONFIG_LV_USE_ARC=y
CONFIG_LV_USE_LABEL=y
CONFIG_LV_USE_BAR=y
CONFIG_LV_USE_LINE=y
CONFIG_LV_USE_CANVAS=y

# FreeRTOS
CONFIG_FREERTOS_HZ=1000
CONFIG_FREERTOS_UNICORE=n

# Logging
CONFIG_LOG_DEFAULT_LEVEL_INFO=y

# WiFi credentials — update via: idf.py menuconfig → SignalK Instrument Panel
# ESP32-C6 supports 2.4GHz only
CONFIG_WIFI_SSID="YourSSID"
CONFIG_WIFI_PASSWORD="YourPassword"

# Fallback URI — only used if mDNS discovery fails to find a SignalK server
# Primary discovery is automatic via mDNS (_signalk-ws._tcp)
CONFIG_SIGNALK_WS_URI="ws://192.168.1.100:3000/signalk/v1/stream?subscribe=none"

# WebSocket TLS - allow insecure for dev (ngrok cert)
CONFIG_ESP_TLS_INSECURE=y
CONFIG_ESP_TLS_SKIP_SERVER_CERT_VERIFY=y

# Stack sizes for websocket task
CONFIG_ESP_MAIN_TASK_STACK_SIZE=8192
```
